## meta-clanton/meta-clanton-bsp/conf/layer.conf
```bitbake
# We have a conf and classes directory, add to BBPATH
BBPATH := "${BBPATH}:${LAYERDIR}"

# We have a recipes directory, add to BBFILES
BBFILES := "${BBFILES} ${LAYERDIR}/recipes-*/*/*.bb \
	${LAYERDIR}/recipes-*/*/*.bbappend"

BBFILE_COLLECTIONS += "clanton-bsp"
BBFILE_PATTERN_clanton-bsp := "^${LAYERDIR}/"
BBFILE_PRIORITY_clanton-bsp = "6"
```

## meta-clanton/meta-clanton-bsp/conf/machine/clanton.conf
```bitbake
#@TYPE: Machine
#@NAME: clanton

#@DESCRIPTION: Machine configuration for clanton systems

PREFERRED_PROVIDER_virtual/kernel ?= "linux-yocto-clanton"
PREFERRED_VERSION_linux-yocto-clanton ?= "3.8%"

require conf/machine/include/ia32-base.inc
include conf/machine/include/tune-i586.inc

#Avoid pulling in GRUB
MACHINE_ESSENTIAL_EXTRA_RDEPENDS = ""

MACHINE_FEATURES = "efi usb pci"

SERIAL_CONSOLE = "115200 ttyS1"
#SERIAL_CONSOLES = "115200;ttyS0 115200;ttyS1"

EXTRA_IMAGEDEPENDS = "grub"
PREFERRED_VERSION_grub = "0.97+git%"
```

## meta-clanton/meta-clanton-distro/conf/distro/clanton-full.conf
```bitbake
require conf/distro/poky.conf
DISTRO = "clanton-full"

PREFERRED_PROVIDER_virtual/kernel = "linux-yocto-clanton"
PREFERRED_VERSION_ethtool = "3.6%"
PREFERRED_VERSION_linux-yocto-clanton = "3.8%"
#PREFERRED_VERSION_grub = "0.97%"

# change these to something better
IMAGE_FSTYPES = "cpio.gz cpio.lzma"

PACKAGE_CLASSES = "package_ipk"

VIRTUAL-RUNTIME_dev_manager = ""
VIRTUAL-RUNTIME_init_manager = "sysvinit"
VIRTUAL-RUNTIME_initscripts = "initscripts"
```

## meta-clanton/meta-clanton-distro/conf/distro/clanton-tiny.conf
```bitbake
require conf/distro/poky-tiny.conf
DISTRO = "clanton-tiny"

# poky-tiny forces linux-yocto-tiny otherwise 
PREFERRED_PROVIDER_virtual/kernel = "linux-yocto-clanton"
PREFERRED_VERSION_linux-yocto-clanton = "3.8%"
PREFERRED_VERSION_ethtool = "3.6%"

VIRTUAL-RUNTIME_dev_manager = ""
VIRTUAL-RUNTIME_init_manager = "sysvinit"
VIRTUAL-RUNTIME_initscripts = "initscripts"

PACKAGE_CLASSES = "package_ipk"

INITRAMFS_TYPES = "cpio.gz cpio.lzma"

# check if these are still necessary - what are they needed for?
DISTRO_FEATURES_LIBC = "libc-posix-clang-wchar libc-posix-wchar-io"

DISTRO_FEATURES = "ipv4 ipv6 ppp xattr alsa argp ${DISTRO_FEATURES_LIBC}"

DISTRO_FEATURES_append_class-nativesdk = " ${DISTRO_FEATURES_LIBC}"

TCLIBC = "uclibc"
```

## meta-clanton/meta-clanton-distro/conf/distro/exclude_from_world.inc
```bitbake
EXCLUDE_FROM_WORLD_pn-tk = "1"
EXCLUDE_FROM_WORLD_pn-xdotool = "1"
EXCLUDE_FROM_WORLD_pn-openbox = "1"
EXCLUDE_FROM_WORLD_pn-xf86-video-vmware = "1"
EXCLUDE_FROM_WORLD_pn-xf86-video-intel = "1"
EXCLUDE_FROM_WORLD_pn-xf86-video-fbdev = "1"
EXCLUDE_FROM_WORLD_pn-xf86-input-mouse = "1"
EXCLUDE_FROM_WORLD_pn-xf86-input-vmmouse = "1"
EXCLUDE_FROM_WORLD_pn-xf86-input-evdev = "1"
EXCLUDE_FROM_WORLD_pn-xf86-input-void = "1"
EXCLUDE_FROM_WORLD_pn-xf86-input-tslib = "1"
EXCLUDE_FROM_WORLD_pn-xf86-video-modesetting = "1"
EXCLUDE_FROM_WORLD_pn-xf86-video-glamo = "1"
EXCLUDE_FROM_WORLD_pn-xf86-video-geode = "1"
EXCLUDE_FROM_WORLD_pn-xf86-video-omap = "1"
EXCLUDE_FROM_WORLD_pn-xf86-video-omapfb = "1"
EXCLUDE_FROM_WORLD_pn-gnuplot = "1"
EXCLUDE_FROM_WORLD_pn-clutter-1.8 = "1"
EXCLUDE_FROM_WORLD_pn-clutter-gst-1.8 = "1"
EXCLUDE_FROM_WORLD_pn-clutter-gtk-1.8 = "1"
EXCLUDE_FROM_WORLD_pn-monav = "1"
EXCLUDE_FROM_WORLD_pn-xset = "1"
EXCLUDE_FROM_WORLD_pn-xrdb = "1"
EXCLUDE_FROM_WORLD_pn-startup-notification = "1"
EXCLUDE_FROM_WORLD_pn-xkbcomp = "1"
EXCLUDE_FROM_WORLD_pn-libxsettings-client = "1"
EXCLUDE_FROM_WORLD_pn-links-x11 = "1"
EXCLUDE_FROM_WORLD_pn-fstests = "1"
EXCLUDE_FROM_WORLD_pn-setxkbmap = "1"
EXCLUDE_FROM_WORLD_pn-xclock = "1"
EXCLUDE_FROM_WORLD_pn-mesa-demos = "1"
EXCLUDE_FROM_WORLD_pn-consolekit = "1"
EXCLUDE_FROM_WORLD_pn-glew = "1"
EXCLUDE_FROM_WORLD_pn-xdpyinfo = "1"
EXCLUDE_FROM_WORLD_pn-qt4-x11-free = "1"
EXCLUDE_FROM_WORLD_pn-qt4-x11 = "1"
EXCLUDE_FROM_WORLD_pn-qt4-mkspecs = "1"
EXCLUDE_FROM_WORLD_pn-qt-mobility-x11 = "1"
EXCLUDE_FROM_WORLD_pn-numlockx = "1"
EXCLUDE_FROM_WORLD_pn-mkfontscale = "1"
EXCLUDE_FROM_WORLD_pn-xvinfo = "1"
EXCLUDE_FROM_WORLD_pn-xinput = "1"
EXCLUDE_FROM_WORLD_pn-matchbox-wm = "1"
EXCLUDE_FROM_WORLD_pn-xmodmap = "1"
EXCLUDE_FROM_WORLD_pn-xev = "1"
EXCLUDE_FROM_WORLD_pn-openmotif = "1"
EXCLUDE_FROM_WORLD_pn-pong-clock = "1"
EXCLUDE_FROM_WORLD_pn-x11perf = "1"
EXCLUDE_FROM_WORLD_pn-mplayer2 = "1"
EXCLUDE_FROM_WORLD_pn-t1lib = "1"
EXCLUDE_FROM_WORLD_pn-xinit = "1"
EXCLUDE_FROM_WORLD_pn-xserver-nodm-init = "1"
EXCLUDE_FROM_WORLD_pn-sessreg = "1"
EXCLUDE_FROM_WORLD_pn-mkfontdir = "1"
EXCLUDE_FROM_WORLD_pn-mkfontdir-native = "1"
EXCLUDE_FROM_WORLD_pn-xprop = "1"
EXCLUDE_FROM_WORLD_pn-x11vnc = "1"
EXCLUDE_FROM_WORLD_pn-lxdm = "1"
EXCLUDE_FROM_WORLD_pn-qemu = "1"
EXCLUDE_FROM_WORLD_pn-xrestop = "1"
EXCLUDE_FROM_WORLD_pn-xpext = "1"
EXCLUDE_FROM_WORLD_pn-iceauth = "1"
EXCLUDE_FROM_WORLD_pn-xauth = "1"
EXCLUDE_FROM_WORLD_pn-rgb = "1"
EXCLUDE_FROM_WORLD_pn-xwininfo = "1"
EXCLUDE_FROM_WORLD_pn-freerdp = "1"
EXCLUDE_FROM_WORLD_pn-xsp = "1"
EXCLUDE_FROM_WORLD_pn-xf86-video-mga = "1"
EXCLUDE_FROM_WORLD_pn-cogl = "1"
EXCLUDE_FROM_WORLD_pn-xeyes = "1"
EXCLUDE_FROM_WORLD_pn-xf86-video-vesa = "1"
EXCLUDE_FROM_WORLD_pn-xrandr = "1"
EXCLUDE_FROM_WORLD_pn-xtscal = "1"
EXCLUDE_FROM_WORLD_pn-twm = "1"
EXCLUDE_FROM_WORLD_pn-xhost = "1"
EXCLUDE_FROM_WORLD_pn-xinput-calibrator = "1"
EXCLUDE_FROM_WORLD_pn-xkeyboard-config = "1"
EXCLUDE_FROM_WORLD_pn-gnome-desktop = "1"
EXCLUDE_FROM_WORLD_pn-libmatchbox = "1"

EXCLUDE_FROM_WORLD_pn-vlc = "1"
EXCLUDE_FROM_WORLD_pn-libxpm = "1"
EXCLUDE_FROM_WORLD_pn-xterm = "1"
EXCLUDE_FROM_WORLD_pn-libxt = "1"
EXCLUDE_FROM_WORLD_pn-puzzles = "1"
EXCLUDE_FROM_WORLD_pn-synergy = "1"
EXCLUDE_FROM_WORLD_pn-rng-tools = "1"
EXCLUDE_FROM_WORLD_pn-argp-standalone = "1"
EXCLUDE_FROM_WORLD_pn-pavucontrol = "1"
EXCLUDE_FROM_WORLD_pn-libcanberra = "1"
EXCLUDE_FROM_WORLD_pn-gtk+3 = "1"
EXCLUDE_FROM_WORLD_pn-libxext = "1"
EXCLUDE_FROM_WORLD_pn-zaurusd = "1"

EXCLUDE_FROM_WORLD_pn-xcb-util-image = "1"
EXCLUDE_FROM_WORLD_pn-xcb-util = "1"
EXCLUDE_FROM_WORLD_pn-libxcb = "1"
EXCLUDE_FROM_WORLD_pn-libxau = "1"
EXCLUDE_FROM_WORLD_pn-mx = "1"
EXCLUDE_FROM_WORLD_pn-libxrandr = "1"
EXCLUDE_FROM_WORLD_pn-waffle = "1"
EXCLUDE_FROM_WORLD_pn-libx11 = "1"
EXCLUDE_FROM_WORLD_pn-libva = "1"
EXCLUDE_FROM_WORLD_pn-libva-intel-driver = "1"
EXCLUDE_FROM_WORLD_pn-va-intel = "1"
EXCLUDE_FROM_WORLD_pn-fltk = "1"
EXCLUDE_FROM_WORLD_pn-matchbox-keyboard = "1"
EXCLUDE_FROM_WORLD_pn-matchbox-desktop = "1"
EXCLUDE_FROM_WORLD_pn-matchbox-panel-2 = "1"
EXCLUDE_FROM_WORLD_pn-matchbox-theme-sato = "1"
EXCLUDE_FROM_WORLD_pn-matchbox-session-sato = "1"
EXCLUDE_FROM_WORLD_pn-libfakekey = "1"
EXCLUDE_FROM_WORLD_pn-libxtst = "1"
EXCLUDE_FROM_WORLD_pn-libxv = "1"
EXCLUDE_FROM_WORLD_pn-xvideo-tests = "1"

EXCLUDE_FROM_WORLD_pn-xcursorgen = "1"
EXCLUDE_FROM_WORLD_pn-libxcursor = "1"
EXCLUDE_FROM_WORLD_pn-libmad = "1"
EXCLUDE_FROM_WORLD_pn-libsdl-mixer = "1"
EXCLUDE_FROM_WORLD_pn-gimp = "1"
EXCLUDE_FROM_WORLD_pn-webkit-gtk = "1"
EXCLUDE_FROM_WORLD_pn-web-webkit = "1"
EXCLUDE_FROM_WORLD_pn-libxmu = "1"
EXCLUDE_FROM_WORLD_pn-xbitmaps = "1"
EXCLUDE_FROM_WORLD_pn-libxi = "1"
EXCLUDE_FROM_WORLD_pn-xf86-input-synaptics = "1"
EXCLUDE_FROM_WORLD_pn-packagegroup-self-hosted = "1"
EXCLUDE_FROM_WORLD_pn-eglibc-utils = "1"
EXCLUDE_FROM_WORLD_pn-packagegroup-core-sdk-gmae = "1"
EXCLUDE_FROM_WORLD_pn-libxi-dev = "1"
EXCLUDE_FROM_WORLD_pn-packagegroup-core-lsb = "1"


EXCLUDE_FROM_WORLD_pn-packagegroup-core-standalone-gmae-sdk-target = "1"
EXCLUDE_FROM_WORLD_pn-packagegroup-qt-toolchain-target = "1"
EXCLUDE_FROM_WORLD_pn-packagegroup-core-clutter = "1"
EXCLUDE_FROM_WORLD_pn-packagegroup-core-x11-sato = "1"
EXCLUDE_FROM_WORLD_pn-packagegroup-core-x11 = "1"
EXCLUDE_FROM_WORLD_pn-packagegroup-core-x11-base = "1"
EXCLUDE_FROM_WORLD_pn-packagegroup-core-x11-xserver = "1"
EXCLUDE_FROM_WORLD_pn-packagegroup-core-qt = "1"
EXCLUDE_FROM_WORLD_pn-xserver-common = "1"
EXCLUDE_FROM_WORLD_pn-x11-common = "1"
EXCLUDE_FROM_WORLD_pn-clutter-box2d = "1"
EXCLUDE_FROM_WORLD_pn-clutter = "1"
EXCLUDE_FROM_WORLD_pn-gtkmathview = "1"
EXCLUDE_FROM_WORLD_pn-t1lib = "1"
EXCLUDE_FROM_WORLD_pn-xcb-util-renderutil = "1"
EXCLUDE_FROM_WORLD_pn-libxcb = "1"
EXCLUDE_FROM_WORLD_pn-libxau = "1"
EXCLUDE_FROM_WORLD_pn-qcanobserver-socketcan = "1"
EXCLUDE_FROM_WORLD_pn-qcanobserver = "1"
EXCLUDE_FROM_WORLD_pn-pidgin = "1"
EXCLUDE_FROM_WORLD_pn-navit = "1"
EXCLUDE_FROM_WORLD_pn-startup-notification = "1"
EXCLUDE_FROM_WORLD_pn-xcb-util-wm = "1"
EXCLUDE_FROM_WORLD_pn-xcb-util-keysyms = "1"
EXCLUDE_FROM_WORLD_pn-xf86-input-mtev = "1"
EXCLUDE_FROM_WORLD_pn-libxfont = "1"
EXCLUDE_FROM_WORLD_pn-maliit-plugins = "1"
EXCLUDE_FROM_WORLD_pn-maliit-framework = "1"
EXCLUDE_FROM_WORLD_pn-fingerterm = "1"
EXCLUDE_FROM_WORLD_pn-fotowall = "1"
EXCLUDE_FROM_WORLD_pn-libconnman-qt = "1"
EXCLUDE_FROM_WORLD_pn-xf86-input-keyboard = "1"
EXCLUDE_FROM_WORLD_pn-imake = "1"
EXCLUDE_FROM_WORLD_pn-xorg-cf-files = "1"
EXCLUDE_FROM_WORLD_pn-xorg-minimal-fonts = "1"
EXCLUDE_FROM_WORLD_pn-font-util = "1"
EXCLUDE_FROM_WORLD_pn-font-util-native = "1"
EXCLUDE_FROM_WORLD_pn-font-alias = "1"
EXCLUDE_FROM_WORLD_pn-encodings = "1"
EXCLUDE_FROM_WORLD_pn-mkfontscale-native = "1"
EXCLUDE_FROM_WORLD_pn-qconnman = "1"
EXCLUDE_FROM_WORLD_pn-qextserialport = "1"
EXCLUDE_FROM_WORLD_pn-quicky = "1"
EXCLUDE_FROM_WORLD_pn-sato-screenshot = "1"
EXCLUDE_FROM_WORLD_pn-gstreamer-vaapi = "1"
EXCLUDE_FROM_WORLD_pn-python-pyqt = "1"
EXCLUDE_FROM_WORLD_pn-python-sip = "1"
EXCLUDE_FROM_WORLD_pn-anki = "1"
EXCLUDE_FROM_WORLD_pn-pcmanfm = "1"
EXCLUDE_FROM_WORLD_pn-qwt = "1"
EXCLUDE_FROM_WORLD_pn-networkmanager = "1"
EXCLUDE_FROM_WORLD_pn-polkit = "1"
EXCLUDE_FROM_WORLD_pn-packagekit = "1"
EXCLUDE_FROM_WORLD_pn-polkit-gnome = "1"
EXCLUDE_FROM_WORLD_pn-upower = "1"
EXCLUDE_FROM_WORLD_pn-devicekit-power = "1"
EXCLUDE_FROM_WORLD_pn-udisks = "1"
EXCLUDE_FROM_WORLD_pn-weston = "1"
```

## meta-clanton/meta-clanton-distro/conf/layer.conf
```bitbake
# We have a conf and classes directory, add to BBPATH
BBPATH := "${BBPATH}:${LAYERDIR}"

# We have a recipes directory, add to BBFILES
BBFILES := "${BBFILES} ${LAYERDIR}/recipes-*/*/*.bb \
	${LAYERDIR}/recipes-*/*/*.bbappend"

BBFILE_COLLECTIONS += "clanton-distro"
BBFILE_PATTERN_clanton-distro := "^${LAYERDIR}/"
BBFILE_PRIORITY_clanton-distro = "6"
```
